## l2mqtt_esp32/main/Kconfig.projbuild
```kconfig
menu "LED and MQTT Configuration"

    orsource "$IDF_PATH/examples/common_components/env_caps/$IDF_TARGET/Kconfig.env_caps"

    config RED_GPIO
        int "Red GPIO number"
        range ENV_GPIO_RANGE_MIN ENV_GPIO_OUT_RANGE_MAX
        default 8 if IDF_TARGET_ESP32C3 || IDF_TARGET_ESP32H2 || IDF_TARGET_ESP32C2
        default 18 if IDF_TARGET_ESP32S2
        default 48 if IDF_TARGET_ESP32S3
        default 21
        help
            GPIO number (IOxx) for the red LED.
            Some GPIOs are used for other purposes (flash connections, etc.) and cannot be used.

    config GREEN_GPIO
        int "Green GPIO number"
        range ENV_GPIO_RANGE_MIN ENV_GPIO_OUT_RANGE_MAX
        default 8 if IDF_TARGET_ESP32C3 || IDF_TARGET_ESP32H2 || IDF_TARGET_ESP32C2
        default 18 if IDF_TARGET_ESP32S2
        default 48 if IDF_TARGET_ESP32S3
        default 19
        help
            GPIO number (IOxx) for the green LED.
            Some GPIOs are used for other purposes (flash connections, etc.) and cannot be used.

    config BLUE_GPIO
        int "Blue GPIO number"
        range ENV_GPIO_RANGE_MIN ENV_GPIO_OUT_RANGE_MAX
        default 8 if IDF_TARGET_ESP32C3 || IDF_TARGET_ESP32H2 || IDF_TARGET_ESP32C2
        default 18 if IDF_TARGET_ESP32S2
        default 48 if IDF_TARGET_ESP32S3
        default 18
        help
            GPIO number (IOxx) for the blue LED.
            Some GPIOs are used for other purposes (flash connections, etc.) and cannot be used.
            
    config BROKER_URL
        string "Broker URL"
        default "mqtt://mqtt.eclipseprojects.io"
        help
            URL of the broker to connect to

endmenu
```
